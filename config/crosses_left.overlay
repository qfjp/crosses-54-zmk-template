&spi1 {
  cs-gpios = <&gpio1 0 GPIO_ACTIVE_LOW>;

  trackball_peripheral: trackball_peripheral@0 {
    status = "okay";
    compatible = "pixart,pmw3610-efogtech";
    reg = <0>;
    spi-max-frequency = <2000000>;
    irq-gpios = <&gpio0 20 (GPIO_ACTIVE_LOW | GPIO_PULL_UP)>;
    cpi = <350>;
    xy-swap;
    /* inverting Y */
    y-invert;
    evt-type = <INPUT_EV_REL>;
    x-input-code = <INPUT_REL_X>;
    y-input-code = <INPUT_REL_Y>;
    force-awake;
    /* keep the sensor awake while ZMK activity state is ACTIVE,
        fallback to normal downshift mode after ZMK goes into IDLE / SLEEP mode.
        thus, the sensor would be a `wakeup-source` */
  };
};
